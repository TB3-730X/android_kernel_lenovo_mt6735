## drivers/input/touchscreen/mediatek/GT9271/Kconfig
```kconfig
#
# Touchscreen driver configuration
#
if TOUCHSCREEN_MTK_GT9271

config GT9271_CONFIG
	string "GT9271 for Mediatek config"

endif
```

## drivers/misc/mediatek/accelerometer/bma223/Kconfig
```kconfig
config MTK_BMA223
	bool "MTK_BMA223 for MediaTek package"
	default n
	help
	  It support different accelerometer sensor.
          If this option is set,
	  it will support
          MTK_BMA223 Accelerometer.

config BMA223_LOWPASS
	bool "MTK_BMA223 for Mediatek package"
	default n
	help
	Say Y here if you have MTK_BMA223 touch panel BMA223_LOWPASS.

	If unsure, say N.

	To compile this dirver as a module, choose M here: the
	module will be called.

config CUSTOM_KERNEL_SENSORHUB
	bool "MTK_BMA223 for Mediatek package"
	default n
	help
	Say Y here if you have MTK_BMA223 touch panel CUSTOM_KERNEL_SENSORHUB.

	If unsure, say N.

	To compile this dirver as a module, choose M here: the
	module will be called.
```

## drivers/misc/mediatek/accelerometer/bmi160_acc/Kconfig
```kconfig
config MTK_BMI160_ACC
	bool "MTK_BMI160_ACC for MediaTek package"
	default n
	help
	  It support different accelerometer sensor.
          If this option is set,
	  it will support
          MTK_BMI160_ACC Accelerometer.

config BMI160_ACC_LOWPASS
	bool "MTK_BMI160_ACC for Mediatek package"
	default n
	help
	Say Y here if you have MTK_BMI160_ACC touch panel BMI160_ACC_LOWPASS.

	If unsure, say N.

	To compile this dirver as a module, choose M here: the
	module will be called.

config CUSTOM_KERNEL_SENSORHUB
	bool "MTK_BMI160_ACC for Mediatek package"
	default n
	help
	Say Y here if you have MTK_BMI160_ACC touch panel CUSTOM_KERNEL_SENSORHUB.

	If unsure, say N.

	To compile this dirver as a module, choose M here: the
	module will be called.
```

## drivers/misc/mediatek/alsps/EM30918/Kconfig
```kconfig
config MTK_EM30918
	bool "EM30918 for MediaTek package"
	default n
	help
	It support different type sensor
	in this platform. If this option
	is set, it will support ambient
	and light sensor EM30918.
```

## drivers/misc/mediatek/mhall/Kconfig
```kconfig
config CUSTOM_KERNEL_MHALL
	bool "CUSTOM_KERNEL_MHALL"
	 

source "drivers/misc/mediatek/mhall/bu52013hfv/Kconfig"
```

## drivers/misc/mediatek/mhall/bu52013hfv/Kconfig
```kconfig
config MTK_BU52013HFV
	bool "MTK_BU52013HFV for MediaTek package"
	default n
	help
	  It support different mall sensor.
          If this option is set,
	  it will support
          MTK_BU52013HFV Accelerometer.

config MTK_BU52013HFV
	bool "MTK_BU52013HFV for Mediatek package"
	default n
	help
	Say Y here if you have MTK_BU52013HFV touch panel MTK_BU52013HFV.

	If unsure, say N.

	To compile this dirver as a module, choose M here: the
	module will be called.
```
