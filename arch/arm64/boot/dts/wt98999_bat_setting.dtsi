/*************************
 * Customized Battery Setting dtsi file
*************************/
&bat_comm {
	/* cust_charging.h */

	/* stop charging while in talking mode */
	stop_charging_in_takling = <1 >;
	talking_recharge_voltage = <3800 >;
	talking_sync_time = <60 >;

	/* Battery Temperature Protection */
	mtk_temperature_recharge_support = <1 >;
	max_charge_temperature = <51 >;
	max_charge_temperature_minus_x_degree = <48 >;
	min_charge_temperature = <0 >;
	min_charge_temperature_plus_x_degree = <2 >;
	err_charge_temperature = <0xff >;

	/* Linear Charging Threshold */
	/* use switch charging so disable linear charging para
	v_pre2cc_thres = <3400 >;
	v_cc2topoff_thres = <4050 >;
	recharging_voltage = <4110 >;
	charging_full_current = <100 >;
	*/

	/* Charging Current Setting */
	usb_charger_current = <50000 >;	/* Unit: 0.01 mA */
	ac_charger_input_current = <160000 >; /* Unit: 0.01 mA */
	ac_charger_current = <100000 >;	/* Unit: 0.01 mA */
	non_std_ac_charger_current = <50000 >;	/* Unit: 0.01 mA */
	charging_host_charger_current = <50000 >;	/* Unit: 0.01 mA */

	/* charger error check */
	bat_low_temp_protect_enable = <1 >;
	v_charger_enable = <0 >;	/* 1:on , 0:off */
	v_charger_max = <6500 >;	/* unit: mV */
	v_charger_min = <4400 >;

	/*  Tracking TIME */
	onehundred_percent_tracking_time = <10 >;	/* Unit: second */
	npercent_tracking_time = <20 >;	/* Unit: second */
	sync_to_real_tracking_time = <60 >;	/* Unit: second */
	v_0percent_tracking = <3400 >;	/* Unit: mV */

	/* High battery support */
	high_battery_voltage_support = <1 >;
};

&bat_meter {
	/* cust_battery_meter.h */
	/* ADC resistor  */
	r_bat_sense = <4 >;
	r_i_sense = <4 >;
	r_charger_1 = <330 >;
	r_charger_2 = <39 >;
	temperature_t0 = <110 >;
	temperature_t1 = <0 >;
	temperature_t2 = <25 >;
	temperature_t3 = <50 >;
	temperature_t = <255 >;	/* this should be fixed, never change the value */
	fg_meter_resistance = <0 >;

	/* Qmax for 0mA */
	q_max_pos_50 = <3412>; //3559
	q_max_pos_25 = <3450>; //3584
	q_max_pos_0 = <3345>; //3484
	q_max_neg_10 = <3303>; //3441
	/* Qmax for 400mA, said high current */
	q_max_pos_50_h_current = <3379>; //3520
	q_max_pos_25_h_current = <3418>; //3560
	q_max_pos_0_h_current = <3169>; //3301
	q_max_neg_10_h_current = <2627>; //2736
	/* Discharge percentage, 1: D5, 0: D2 */
	oam_d5 = <1 >;

	change_tracking_point = <1 >;
	/* SW OCV tracking setting */
	cust_tracking_point = <1 >;
	cust_r_sense = <68 >;
	cust_hw_cc = <0 >;
	aging_tuning_value = <103 >;
	cust_r_fg_offset = <0 >;
	ocv_board_compesate = <0 >;
	r_fg_board_base = <1000 >;
	r_fg_board_slope = <1000 >;
	car_tune_value = <99 >;

	/* HW Fuel gague  */
	current_detect_r_fg = <10 >;	/* Unit: mA */
	minerroroffset = <1000 >;
	fg_vbat_average_size = <18 >;
	r_fg_value = <10 >;	/* Unit: mOhm */

	cust_poweron_delta_capacity_tolrance = <25 >;
	cust_poweron_low_capacity_tolrance = <0 >;
	cust_poweron_max_vbat_tolrance = <90 >;
	cust_poweron_delta_vbat_tolrance = <30 >;
	cust_poweron_delta_hw_sw_ocv_capacity_tolrance = <10 >;

	/* Fixed battery temperature */
	fixed_tbat_25 = <0 >;

	/* Battery remove detecton */
	vbat_remove_detection = <0>;

	/* Dynamic change wake up period of battery thread when suspend */
	vbat_normal_wakeup = <3600 >;	/* Unit: mV */
	vbat_low_power_wakeup = <3500 >;	/* Unit: mV */
	normal_wakeup_period = <5400 >;	/* Unit: second */
	low_power_wakeup_period = <300 >;	/* Unit: second */
	close_poweroff_wakeup_period = <30 >;	/* Unit: second */

	rbat_pull_up_r = <16900 >;
	rbat_pull_up_volt = <1800 >;

	batt_temperature_table_num = <17 >;
	batt_temperature_table = <
	(-20) 69709
	(-15) 54633
	(-10) 43155
	(-5)	34343
	0	27523
	5	22206
	10	18031
	15	14730
	20	12103
	25	10000
	30	8306
	35	6935
	40	5818
	45	4904
	50	4152
	55	3531
	60	3016
	>;

	battery_profile_t0_num = <72 >;
	battery_profile_t0 = <
	0	4333
	2	4308
	3	4287
	5	4269
	6	4249
	8	4232
	9	4214
	11	4197
	13	4180
	14	4163
	16	4145
	17	4129
	19	4113
	20	4096
	22	4080
	24	4064
	25	4048
	27	4031
	28	4012
	30	3993
	31	3976
	33	3962
	34	3948
	36	3934
	38	3921
	39	3909
	41	3897
	42	3885
	44	3875
	45	3865
	47	3856
	49	3847
	50	3839
	52	3831
	53	3824
	55	3816
	56	3811
	58	3804
	59	3799
	61	3793
	62	3788
	64	3783
	66	3778
	67	3773
	69	3770
	70	3766
	72	3763
	73	3758
	75	3754
	76	3748
	78	3741
	79	3733
	81	3724
	83	3714
	84	3705
	86	3699
	87	3693
	89	3688
	90	3683
	92	3678
	93	3668
	95	3641
	96	3596
	97	3560
	98	3549
	98	3543
	98	3538
	99	3533
	99	3527
	99	3522
	99	3516
	100   3510
	>;

	battery_profile_t1_num = <72 >;
	battery_profile_t1 = <
	0	4337
	2	4315
	3	4296
	5	4279
	6	4261
	8	4243
	9	4226
	11	4209
	12	4192
	14	4175
	15	4158
	17	4142
	19	4125
	20	4110
	22	4094
	23	4078
	25	4064
	26	4048
	28	4031
	29	4015
	31	3998
	33	3982
	34	3969
	36	3954
	37	3940
	39	3926
	40	3913
	42	3900
	43	3889
	45	3878
	46	3868
	48	3860
	50	3851
	51	3844
	53	3837
	54	3829
	56	3823
	57	3817
	59	3812
	60	3807
	62	3801
	63	3796
	65	3792
	67	3787
	68	3784
	70	3779
	71	3776
	73	3773
	74	3769
	76	3765
	77	3759
	79	3752
	81	3742
	82	3732
	84	3720
	85	3711
	87	3704
	88	3700
	90	3697
	91	3692
	93	3688
	94	3680
	96	3655
	98	3606
	99	3545
	100   3448
	100   3400
	100   3400
	100   3400
	100   3400
	100   3400
	100   3400
	>;

	battery_profile_t2_num = <72 >;
	battery_profile_t2 = <
	0	4333
	2	4312
	3	4294
	5	4276
	6	4258
	8	4241
	9	4224
	11	4207
	12	4190
	14	4174
	15	4157
	17	4141
	18	4126
	20	4110
	21	4095
	23	4080
	24	4065
	26	4051
	27	4037
	29	4022
	30	4009
	32	3996
	33	3984
	35	3972
	36	3963
	38	3951
	39	3940
	41	3928
	42	3913
	44	3897
	45	3881
	47	3867
	48	3856
	50	3846
	51	3838
	53	3830
	54	3824
	56	3818
	57	3811
	59	3806
	60	3801
	62	3797
	63	3792
	65	3787
	66	3784
	68	3780
	69	3776
	71	3773
	72	3771
	74	3768
	75	3764
	77	3760
	78	3753
	80	3748
	81	3741
	83	3733
	84	3721
	86	3710
	87	3695
	89	3687
	90	3684
	92	3682
	93	3680
	95	3676
	96	3663
	98	3605
	99	3513
	100   3400
	100   3400
	100   3400
	100   3400
	100   3400
	>;

	battery_profile_t3_num = <72 >;
	battery_profile_t3 = <
	0	4323
	2	4301
	3	4282
	5	4265
	6	4247
	8	4230
	9	4213
	11	4195
	12	4179
	14	4163
	15	4147
	17	4130
	18	4115
	20	4098
	21	4083
	23	4067
	24	4052
	26	4038
	27	4024
	29	4010
	30	3997
	32	3984
	33	3971
	35	3962
	36	3950
	38	3939
	39	3929
	41	3918
	42	3906
	44	3892
	45	3874
	47	3857
	49	3846
	50	3837
	52	3828
	53	3821
	55	3814
	56	3808
	58	3802
	59	3796
	61	3790
	62	3786
	64	3780
	65	3776
	67	3772
	68	3768
	70	3765
	71	3759
	73	3749
	74	3741
	76	3737
	77	3731
	79	3725
	80	3718
	82	3711
	83	3703
	85	3689
	86	3676
	88	3663
	89	3659
	91	3658
	92	3656
	94	3651
	95	3643
	97	3597
	98	3521
	100   3401
	100   3400
	100   3400
	100   3400
	100   3400
	100   3400
	>;

	r_profile_t0_num = <72 >;
	r_profile_t0 = <
	482 4333
	482 4308
	480 4287
	487 4269
	478 4249
	483 4232
	485 4214
	488 4197
	490 4180
	495 4163
	490 4145
	493 4129
	495 4113
	495 4096
	495 4080
	495 4064
	493 4048
	492 4031
	488 4012
	480 3993
	480 3976
	480 3962
	477 3948
	473 3934
	470 3921
	468 3909
	467 3897
	465 3885
	468 3875
	467 3865
	468 3856
	470 3847
	472 3839
	472 3831
	477 3824
	473 3816
	477 3811
	480 3804
	485 3799
	488 3793
	488 3788
	497 3783
	497 3778
	500 3773
	505 3770
	507 3766
	517 3763
	518 3758
	528 3754
	533 3748
	542 3741
	550 3733
	560 3724
	567 3714
	578 3705
	592 3699
	610 3693
	632 3688
	662 3683
	702 3678
	750 3668
	795 3641
	862 3596
	933 3560
	915 3549
	905 3543
	897 3538
	888 3533
	878 3527
	870 3522
	860 3516
	850 3510
	>;

	r_profile_t1_num = <72 >;
	r_profile_t1 = <
	298 4337
	298 4315
	302 4296
	307 4279
	307 4261
	310 4243
	312 4226
	313 4209
	315 4192
	318 4175
	325 4158
	322 4142
	323 4125
	328 4110
	330 4094
	330 4078
	335 4064
	333 4048
	333 4031
	335 4015
	332 3998
	327 3982
	327 3969
	323 3954
	318 3940
	315 3926
	312 3913
	308 3900
	307 3889
	307 3878
	305 3868
	308 3860
	307 3851
	310 3844
	312 3837
	310 3829
	312 3823
	315 3817
	317 3812
	318 3807
	320 3801
	320 3796
	323 3792
	323 3787
	325 3784
	323 3779
	323 3776
	325 3773
	327 3769
	330 3765
	332 3759
	333 3752
	335 3742
	338 3732
	345 3720
	343 3711
	345 3704
	357 3700
	370 3697
	387 3692
	415 3688
	452 3680
	492 3655
	543 3606
	618 3545
	723 3448
	653 3400
	653 3400
	653 3400
	653 3400
	653 3400
	653 3400
	>;

	r_profile_t2_num = <72 >;
	r_profile_t2 = <
	87   4333
	133 4312
	137 4294
	137 4276
	138 4258
	140 4241
	142 4224
	142 4207
	143 4190
	145 4174
	147 4157
	148 4141
	152 4126
	153 4110
	155 4095
	157 4080
	158 4065
	157 4051
	158 4037
	162 4022
	163 4009
	165 3996
	168 3984
	170 3972
	177 3963
	177 3951
	178 3940
	177 3928
	170 3913
	160 3897
	150 3881
	145 3867
	142 3856
	140 3846
	140 3838
	140 3830
	143 3824
	143 3818
	143 3811
	145 3806
	147 3801
	148 3797
	150 3792
	150 3787
	152 3784
	152 3780
	152 3776
	152 3773
	155 3771
	155 3768
	153 3764
	152 3760
	147 3753
	148 3748
	147 3741
	150 3733
	148 3721
	150 3710
	148 3695
	145 3687
	147 3684
	150 3682
	158 3680
	167 3676
	182 3663
	173 3605
	187 3513
	213 3400
	213 3400
	213 3400
	213 3400
	213 3400
	>;

	r_profile_t3_num = <72 >;
	r_profile_t3 = <
	123 4323
	123 4301
	120 4282
	123 4265
	123 4247
	123 4230
	123 4213
	122 4195
	123 4179
	125 4163
	128 4147
	127 4130
	130 4115
	130 4098
	128 4083
	132 4067
	130 4052
	130 4038
	130 4024
	130 4010
	132 3997
	132 3984
	132 3971
	140 3962
	145 3950
	147 3939
	150 3929
	153 3918
	155 3906
	152 3892
	142 3874
	130 3857
	127 3846
	127 3837
	123 3828
	123 3821
	123 3814
	128 3808
	128 3802
	130 3796
	128 3790
	133 3786
	130 3780
	135 3776
	135 3772
	135 3768
	138 3765
	137 3759
	128 3749
	127 3741
	130 3737
	127 3731
	128 3725
	127 3718
	128 3711
	127 3703
	127 3689
	127 3676
	127 3663
	123 3659
	125 3658
	130 3656
	130 3651
	138 3643
	128 3597
	142 3521
	148 3401
	190 3400
	190 3400
	190 3400
	190 3400
	190 3400
	>;
};
